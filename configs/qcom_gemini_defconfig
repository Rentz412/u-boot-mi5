## configs/qcom_gemini_defconfig
```kconfig
CONFIG_ARM=y
CONFIG_ARCH_SNAPDRAGON=y
CONFIG_QCOM_GEMINI=y
CONFIG_SYS_BOARD="gemini"
CONFIG_SYS_CONFIG_NAME="qcom"
CONFIG_SKIP_LOWLEVEL_INIT=y
CONFIG_POSITION_INDEPENDENT=y
CONFIG_SYS_INIT_SP_BSS_OFFSET=0x180000
CONFIG_NR_DRAM_BANKS=24
CONFIG_DEFAULT_DEVICE_TREE="qcom/msm8996-xiaomi-gemini"
CONFIG_SYS_LOAD_ADDR=0xA0000000
CONFIG_TEXT_BASE=0x80000000
CONFIG_BOOTDELAY=0
CONFIG_ENV_IS_NOWHERE=y
CONFIG_SYS_CONSOLE_IS_IN_ENV=y
CONFIG_SYS_DEVICE_NULLDEV=y
CONFIG_ENV_USE_DEFAULT_ENV_TEXT_FILE=y
CONFIG_ENV_DEFAULT_ENV_TEXT_FILE="board/qualcomm/gemini/gemini.env"
CONFIG_PANIC_HANG=y
CONFIG_DISPLAY_BOARDINFO_LATE=y
CONFIG_CMD_SLEEP=y
CONFIG_SYS_CBSIZE=4096
CONFIG_SYS_MAXARGS=32
# CONFIG_REQUIRE_SERIAL_CONSOLE is not set
# CONFIG_OF_UPSTREAM is not set
# CONFIG_NET is not set
# CONFIG_EFI_LOADER is not set
# CONFIG_TOOLS_MKEFICAPSULE is not set
# CONFIG_TOOLS_MKFWUMDATA is not set
# CONFIG_CMD_BOOTEFI is not set
# CONFIG_CMD_NET is not set
# CONFIG_DISTRO_DEFAULTS is not set
# CONFIG_DISPLAY_CPUINFO is not set
# CONFIG_MMC is not set
# CONFIG_CMD_MMC is not set
# CONFIG_USB is not set
# CONFIG_SCSI is not set
# CONFIG_EXT4_WRITE is not set
# CONFIG_BLOCK_CACHE is not set
# CONFIG_BOOTSTD is not set
```
